## boards/shields/splayney/Kconfig.defconfig
```kconfig
if SHIELD_SPLAYNEY_LEFT

config ZMK_KEYBOARD_NAME
    default "splayney"

config ZMK_SPLIT_BLE_ROLE_CENTRAL
    default y

endif

if SHIELD_SPLAYNEY_LEFT || SHIELD_SPLAYNEY_RIGHT

config ZMK_SPLIT
    default y
    
endif
```

## boards/shields/splayney/Kconfig.shield
```kconfig
config SHIELD_SPLAYNEY_LEFT
	def_bool $(shields_list_contains,splayney_left)

config SHIELD_SPLAYNEY_RIGHT
	def_bool $(shields_list_contains,splayney_right)
```
