// my_keyboard_right.overlay

#include "splayney.dtsi"

&default_transform { // Offset of 3 because the left side has 3 columns
    col-offset = <7>;
};

&kscan0 {
    
    col-gpios = <&pro_micro 6 GPIO_ACTIVE_HIGH> // C0 p0.06
              , <&pro_micro 8 GPIO_ACTIVE_HIGH> // C1 p0.08
              , <&pro_micro 17 GPIO_ACTIVE_HIGH> // C2 p0.17

              , <&pro_micro 0 GPIO_ACTIVE_HIGH> // C5 p1.00
              , <&pro_micro 11 GPIO_ACTIVE_HIGH> // C4 p0.11
              , <&pro_micro 4 GPIO_ACTIVE_HIGH> // C3 p1.04
              , <&pro_micro 6 GPIO_ACTIVE_HIGH> // C6 p1.06
              , <&pro_micro 9 GPIO_ACTIVE_HIGH>; // C7 p0.09
};